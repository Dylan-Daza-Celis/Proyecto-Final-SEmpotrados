## Proyecto_Final_C6/main/Kconfig.projbuild
```kconfig
menu "Semaforos - demostracion autonoma"
config SEMAFORO_PINOUT_CONFIRMADO
    bool "He confirmado placa, GPIO y cableado provisional"
    default n
choice SEMAFORO_MODO
    prompt "Modo de demostracion"
    default SEMAFORO_CONVENCIONAL
config SEMAFORO_CONVENCIONAL
    bool "Demostracion convencional"
config SEMAFORO_ADAPTATIVO
    bool "Demostracion adaptativa con demanda simulada"
config SEMAFORO_CONECTADO
    bool "Adaptativo conectado por UDP ASCII"
endchoice
config SEMAFORO_SIMULAR_DEMANDA
    bool "Inyectar escenarios de demanda simulada"
    depends on !SEMAFORO_CONECTADO
    default y if SEMAFORO_ADAPTATIVO
    default n
config SEMAFORO_VERDE_1_MS
    int "Verde convencional carril 1 (ms)"
    range 5000 13000
    default 5000
config SEMAFORO_VERDE_2_MS
    int "Verde convencional carril 2 (ms)"
    range 5000 13000
    default 5000
config SEMAFORO_VERDE_MIN_MS
    int "Verde adaptativo minimo (ms)"
    range 5000 13000
    default 5000
config SEMAFORO_VERDE_MAX_MS
    int "Verde adaptativo maximo (ms)"
    range 5000 13000
    default 13000
config SEMAFORO_UMBRAL
    int "Diferencia minima para prioridad (vehiculos)"
    range 1 1000
    default 2
config SEMAFORO_INCREMENTO_MS
    int "Incremento por nivel (ms)"
    range 1 8000
    default 2000
config SEMAFORO_OBJETIVO_SIN_VERDE_MS
    int "Objetivo nominal maximo sin verde (ms)"
    range 10000 20000
    default 20000
config SEMAFORO_MAX_EDAD_DEMANDA_MS
    int "Vigencia maxima local de demanda (ms)"
    range 100 60000
    default 5000
config SEMAFORO_AMARILLO_MS
    int "Amarillo (ms)"
    range 2000 10000
    default 2000
config SEMAFORO_ROJO_TOTAL_MS
    int "Rojo total (ms)"
    range 1000 10000
    default 1000
config SEMAFORO_WIFI_SSID
    string "SSID local 2.4 GHz (no versionar sdkconfig)"
    default ""
config SEMAFORO_WIFI_PASSWORD
    string "Contrasena Wi-Fi local"
    default ""
config SEMAFORO_UDP_PUERTO
    int "Puerto UDP"
    range 1 65535
    default 5005
config SEMAFORO_UDP_TIMEOUT_LOCAL_MS
    int "Timeout local desde ultima observacion valida (ms)"
    range 100 60000
    default 5000
config SEMAFORO_UDP_IP_EMISOR
    string "IPv4 del emisor permitido (vacio acepta cualquier IP LAN)"
    default ""
endmenu
```

## Proyecto_Final_Cam/main/Kconfig.projbuild
```kconfig
menu "Semáforo inteligente - conexión local"
    config PROYECTO_WIFI_SSID
        string "SSID de la red Wi-Fi de 2.4 GHz"
        default ""
        help
            Introducir localmente. sdkconfig y los binarios contienen este valor;
            no publicarlos ni copiar credenciales a sdkconfig.defaults.

    config PROYECTO_WIFI_PASSWORD
        string "Contraseña Wi-Fi (vacía únicamente para una red abierta)"
        default ""
        help
            Credencial local guardada en sdkconfig, ignorado por Git.
endmenu
```
